#include "ws2812_SPI.h"

uint8_t ws2812_buffer[WS2812_BUFFER_SIZE];

// set all pixels to 0 (off)
void ws2812_init(void)
{
  memset(ws2812_buffer, 0, WS2812_BUFFER_SIZE); // fill buffer with 0s
  HAL_SPI_Transmit_DMA(&hspi2, ws2812_buffer, WS2812_BUFFER_SIZE); // write buffer to LEDs
  ws2812_pixel_all(&(PixelRGB_t){0, 0, 0}); // set LEDs to black
}

// set one pixel to given color
void ws2812_pixel(uint8_t _x, uint8_t _y, PixelRGB_t* color)
{
  uint8_t* ptr = &ws2812_buffer[24 * coord2Index(_x, _y)];
  WS2812_FILL_BUFFER(color->color.g);
  WS2812_FILL_BUFFER(color->color.r);
  WS2812_FILL_BUFFER(color->color.b);
}

// set all pixels to given color
void ws2812_pixel_all(PixelRGB_t* color)
{
  uint8_t* ptr = ws2812_buffer;
  for (uint16_t i = 0; i < WS2812_NUM_LEDS; ++i) 
  {
    WS2812_FILL_BUFFER(color->color.g);
    WS2812_FILL_BUFFER(color->color.r);
    WS2812_FILL_BUFFER(color->color.b);
  }
}

// draw picture on matrix
void ws2812_pixel_pic(PixelRGB_t* picture[WS2812_NUM_LEDS_Y][WS2812_NUM_LEDS_X])
{
  for (uint8_t x = 0; x < WS2812_NUM_LEDS_X; x++)
  {
    for (uint8_t y = 0; y < WS2812_NUM_LEDS_Y; y++)
    {
      ws2812_pixel(x, y, picture[y][x]);
    }
  }
}

void HAL_SPI_TxCpltCallback(SPI_HandleTypeDef * hspi)
{
  // Restart transmission when buffer tx is completed
  HAL_SPI_Transmit_DMA(&hspi2, ws2812_buffer, WS2812_BUFFER_SIZE);
}

uint16_t coord2Index (uint8_t _x, uint8_t _y)
{
  /* this is ugly but fast */
  static const uint16_t lookup_table[WS2812_NUM_LEDS_Y][WS2812_NUM_LEDS_X] = { // see src/lookup_table
{   0,  1,  2,  3,  4,  5,  6,  7,192,193,194,195,196,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774,775 },
{   8,  9, 10, 11, 12, 13, 14, 15,200,201,202,203,204,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782,783 },
{  16, 17, 18, 19, 20, 21, 22, 23,208,209,210,211,212,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790,791 },
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{ 184,185,186,187,188,189,190,191,376,377,378,379,380,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958,959 }

};

  if (_x > WS2812_NUM_LEDS_X - 1) _x = WS2812_NUM_LEDS_X - 1;
  if (_y > WS2812_NUM_LEDS_Y - 1) _y = WS2812_NUM_LEDS_Y - 1;

  return lookup_table[_y][_x];
}
